## yocto/conf/bblayers.conf
```bitbake
# Yocto build layers configuration
BBLAYERS ?= " \
  ${BSPDIR}/poky/meta \
  ${BSPDIR}/poky/meta-poky \
  ${BSPDIR}/poky/meta-yocto-bsp \
  ${BSPDIR}/poky/meta-sato \
  ${BSPDIR}/../meta-rust-spray \
  "
```

## yocto/conf/local.conf
```bitbake
# Local Yocto configuration
DISTRO ?= "poky"
PACKAGE_CLASSES ?= "package_rpm"
EXTRA_IMAGE_FEATURES ?= "debug-tweaks"
USER_CLASSES ?= "buildstats image-mklibs image-prelink"

CONF_VERSION = "2"
```
